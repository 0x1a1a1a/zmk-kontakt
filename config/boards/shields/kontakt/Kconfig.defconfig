## config/boards/shields/kontakt/Kconfig.defconfig
```kconfig
config ZMK_KEYBOARD_NAME
    default "Kontakt"




if SHIELD_KONTAKT_RIGHT

config ZMK_SPLIT_ROLE_CENTRAL
    default y

endif




if SHIELD_KONTAKT_LEFT || SHIELD_KONTAKT_RIGHT

config ZMK_SPLIT
    default y

endif
```

## config/boards/shields/kontakt/Kconfig.shield
```kconfig
config SHIELD_KONTAKT_LEFT
    def_bool $(shields_list_contains,kontakt_left)

config SHIELD_KONTAKT_RIGHT
    def_bool $(shields_list_contains,kontakt_right)
```
